## LogTest/main/Kconfig.projbuild
```kconfig
menu "LED Config"
    config LED_GPIO_NUM
        int
        prompt "ESP主板到LED的GPIO号码"
        range 0 50
        default 3
        help
            一般来说这个LED GPIO 号码会写在板子的正面或者背面
    config DELAY_TIME_MS
        int
        prompt "闪烁时间 毫秒"
        range 100 10000
        default 1000
        help
            闪烁时间
endmenu
```
